## meta-oe-fixups/conf/layer.conf
```bitbake
# We have a conf and classes directory, add to BBPATH
BBPATH .= ":${LAYERDIR}"

# We have a packages directory, add to BBFILES
BBFILES += "${LAYERDIR}/recipes-*/*/*.bb \
            ${LAYERDIR}/recipes-*/*/*.bbappend"

BBFILE_COLLECTIONS += "oe-fixups"
BBFILE_PATTERN_oe-fixups := "^${LAYERDIR}/"
BBFILE_PRIORITY_oe-fixups = "8"

# This should only be incremented on significant changes that will
# cause compatibility issues with other layers
LAYERSERIES_COMPAT_oe-fixups = "kirkstone"
```

## meta-xt-cogent-fixups/conf/layer.conf
```bitbake
# We have a conf and classes directory, add to BBPATH
BBPATH .= ":${LAYERDIR}"

# We have a packages directory, add to BBFILES
BBFILES += "${LAYERDIR}/recipes-*/*/*.bb \
            ${LAYERDIR}/recipes-*/*/*.bbappend"

BBFILE_COLLECTIONS += "cogent-fixups"
BBFILE_PATTERN_cogent-fixups := "^${LAYERDIR}/"
BBFILE_PRIORITY_cogent-fixups = "8"

# This should only be incremented on significant changes that will
# cause compatibility issues with other layers
LAYERSERIES_COMPAT_cogent-fixups = "kirkstone"
```

## meta-xt-gateway/meta-xt-domx-gen4/conf/layer.conf
```bitbake
# We have a conf and classes directory, add to BBPATH
BBPATH .= ":${LAYERDIR}"

# We have a packages directory, add to BBFILES
BBFILES += "${LAYERDIR}/recipes-*/*/*.bb \
            ${LAYERDIR}/recipes-*/*/*.bbappend"

BBFILE_COLLECTIONS += "meta-xt-rcar-domx-gen4"
BBFILE_PATTERN_meta-xt-rcar-domx-gen4 := "^${LAYERDIR}/"
BBFILE_PRIORITY_meta-xt-rcar-domx-gen4 = "10"

LAYERSERIES_COMPAT_meta-xt-rcar-domx-gen4 = "dunfell"
```

## meta-xt-rcar-dom0/conf/layer.conf
```bitbake
# We have a conf and classes directory, add to BBPATH
BBPATH .= ":${LAYERDIR}"

# We have a packages directory, add to BBFILES
BBFILES += "${LAYERDIR}/recipes-*/*/*.bb \
            ${LAYERDIR}/recipes-*/*/*.bbappend"

BBFILE_COLLECTIONS += "rcar-dom0"
BBFILE_PATTERN_rcar-dom0 := "^${LAYERDIR}/"
BBFILE_PRIORITY_rcar-dom0 = "7"

# This should only be incremented on significant changes that will
# cause compatibility issues with other layers
LAYERSERIES_COMPAT_rcar-dom0 = "kirkstone"
```

## meta-xt-rcar-domx/conf/layer.conf
```bitbake
# We have a conf and classes directory, add to BBPATH
BBPATH .= ":${LAYERDIR}"

# We have a packages directory, add to BBFILES
BBFILES += "${LAYERDIR}/recipes-*/*/*.bb \
            ${LAYERDIR}/recipes-*/*/*.bbappend"

BBFILE_COLLECTIONS += "rcar-domx"
BBFILE_PATTERN_rcar-domx := "^${LAYERDIR}/"
BBFILE_PRIORITY_rcar-domx = "6"

LAYERSERIES_COMPAT_rcar-domx = "thud warrior zeus dunfell"
```

## meta-xt-rcar-driver-domain/conf/layer.conf
```bitbake
# We have a conf and classes directory, add to BBPATH
BBPATH .= ":${LAYERDIR}"

# We have a packages directory, add to BBFILES
BBFILES += "${LAYERDIR}/recipes-*/*/*.bb \
            ${LAYERDIR}/recipes-*/*/*.bbappend"

BBFILE_COLLECTIONS += "rcar-driver-domain"
BBFILE_PATTERN_rcar-driver-domain := "^${LAYERDIR}/"
BBFILE_PRIORITY_rcar-driver-domain = "6"

# This should only be incremented on significant changes that will
# cause compatibility issues with other layers
LAYERDEPENDS_rcar-driver-domain = "rcar-gen3"

LAYERSERIES_COMPAT_rcar-driver-domain = "thud warrior zeus dunfell"
```

## meta-xt-rcar-gles_common/conf/layer.conf
```bitbake
# We have a conf and classes directory, add to BBPATH
BBPATH =. "${LAYERDIR}:"

# We have recipes-* directories, add to BBFILES
BBFILES += "${LAYERDIR}/recipes-*/*/*.bb \
            ${LAYERDIR}/recipes-*/*/*.bbappend"

BBFILE_COLLECTIONS += "xt-rcar-gles_common"
BBFILE_PATTERN_xt-rcar-gles_common = "^${LAYERDIR}/"
BBFILE_PRIORITY_xt-rcar-gles_common = "6"

LAYERSERIES_COMPAT_xt-rcar-gles_common = "kirkstone"
```

## meta-xt-rcar-proprietary/conf/layer.conf
```bitbake
# We have a conf and classes directory, add to BBPATH
BBPATH =. "${LAYERDIR}:"

# We have recipes-* directories, add to BBFILES
BBFILES += "${LAYERDIR}/recipes-*/*/*.bb \
            ${LAYERDIR}/recipes-*/*/*.bbappend"

BBFILE_COLLECTIONS += "xt-rcar-proprietary"
BBFILE_PATTERN_xt-rcar-proprietary = "^${LAYERDIR}/"
BBFILE_PRIORITY_xt-rcar-proprietary = "6"

LAYERSERIES_COMPAT_xt-rcar-proprietary = "kirkstone"
```
